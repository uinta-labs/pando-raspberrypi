## layers/meta-pando-raspberrypi/conf/layer.conf
```bitbake
BBPATH .= ":${LAYERDIR}"

BBFILES += "${LAYERDIR}/recipes-*/*/*.bb \
            ${LAYERDIR}/recipes-*/*/*.bbappend"

BBFILE_COLLECTIONS += "pando-raspberrypi"
BBFILE_PATTERN_pando-raspberrypi := "^${LAYERDIR}/"
BBFILE_PRIORITY_pando-raspberrypi = "1337"

LAYERSERIES_COMPAT_pando-raspberrypi = "scarthgap"

# As per https://github.com/balena-os/meta-balena/pull/2411
# we only do this for the Pi3-64 Pi4-64, which don't have
# enough rootfs space for the Honister update.
FULL_OPTIMIZATION:raspberrypi4-64 = "-Os -pipe ${DEBUG_FLAGS}"
FULL_OPTIMIZATION:raspberrypi3-64 = "-Os -pipe ${DEBUG_FLAGS}"

KERNEL_DEVICETREE:append:fincm3 = " overlays/balena-fin.dtbo"

# Helps switch SPI function block to GPIOs 40-45 during HUP
# for updating boot EEPROM on RPI4
KERNEL_DEVICETREE:append:raspberrypi4-64 = " overlays/spi-gpio40-45.dtbo"

# We use udev rules to create serial device aliases
SERIAL_CONSOLES = "115200;serial0"

# Note: We do not include the raspberrypi-400.dtb
# in the rootfs, raspbian doesn't either. Including it
# breaks usb boot in u-boot, as well as the usb2.0 port
# and the mouse support in the kernel.

RPI_KERNEL_DEVICETREE:append:raspberrypi3-64 = " broadcom/bcm2710-rpi-cm3.dtb"

RPI_KERNEL_DEVICETREE:append:raspberrypi4-64 = " broadcom/bcm2711-rpi-400.dtb"
RPI_KERNEL_DEVICETREE:append:raspberrypi4-64 = " broadcom/bcm2711-rpi-cm4.dtb"
# RPI_KERNEL_DEVICETREE:append:revpi-connect-s = " broadcom/bcm2711-rpi-cm4s.dtb"

# RPI_KERNEL_DEVICETREE:remove:revpi-connect = "bcm2711-rpi-cm4s.dtb"
# RPI_KERNEL_DEVICETREE:remove:revpi-core-3 = "bcm2711-rpi-cm4s.dtb"

# RPI_KERNEL_DEVICETREE:remove = " \
#     broadcom/bcm2708-rpi-zero.dtb \
#     broadcom/bcm2708-rpi-zero-w.dtb \
#     broadcom/bcm2708-rpi-b.dtb \
#     broadcom/bcm2708-rpi-b-rev1.dtb \
#     broadcom/bcm2708-rpi-b-plus.dtb \
#     broadcom/bcm2709-rpi-2-b.dtb \
#     broadcom/bcm2710-rpi-2-b.dtb \
#     broadcom/bcm2710-rpi-zero-2.dtb \
# "
#     broadcom/bcm2710-rpi-3-b.dtb \
#     broadcom/bcm2710-rpi-3-b-plus.dtb \
#     broadcom/bcm2710-rpi-zero-2.dtb \
#     broadcom/bcm2711-rpi-4-b.dtb \
#     broadcom/bcm2711-rpi-400.dtb \
#     broadcom/bcm2708-rpi-cm.dtb \
#     broadcom/bcm2710-rpi-cm3.dtb \
#     broadcom/bcm2711-rpi-cm4.dtb \
#     broadcom/bcm2711-rpi-cm4s.dtb \
#     broadcom/bcm2712-rpi-5-b.dtb \
#     "

# RPI_KERNEL_DEVICETREE:append = " \
#     broadcom/bcm2710-rpi-3-b.dtb \
#     broadcom/bcm2710-rpi-3-b-plus.dtb \
#     broadcom/bcm2710-rpi-zero-2.dtb \
#     broadcom/bcm2711-rpi-4-b.dtb \
#     broadcom/bcm2711-rpi-400.dtb \
#     broadcom/bcm2710-rpi-cm3.dtb \
#     broadcom/bcm2711-rpi-cm4.dtb \
#     broadcom/bcm2711-rpi-cm4s.dtb \
#     broadcom/bcm2712-rpi-5-b.dtb \
#     "



RPI_KERNEL_DEVICETREE ?= " \
    bcm2708-rpi-zero.dtb \
    bcm2708-rpi-zero-w.dtb \
    bcm2708-rpi-b.dtb \
    bcm2708-rpi-b-rev1.dtb \
    bcm2708-rpi-b-plus.dtb \
    bcm2709-rpi-2-b.dtb \
    bcm2710-rpi-2-b.dtb \
    bcm2710-rpi-3-b.dtb \
    bcm2710-rpi-3-b-plus.dtb \
    bcm2710-rpi-zero-2.dtb \
    bcm2711-rpi-4-b.dtb \
    bcm2711-rpi-400.dtb \
    bcm2708-rpi-cm.dtb \
    bcm2710-rpi-cm3.dtb \
    bcm2711-rpi-cm4.dtb \
    bcm2711-rpi-cm4s.dtb \
    bcm2712-rpi-5-b.dtb \
    "


PREFERRED_VERSION_linux-raspberrypi = "6.1%"

# for the raspberrypi0-2w-64 we remain on 5.15 because of WiFi firmware related issues
PREFERRED_VERSION_linux-raspberrypi:raspberrypi0-2w-64 = "5.15.%"

FIRMWARE_COMPRESSION:raspberrypi4-64 ?= "1"
FIRMWARE_COMPRESSION:raspberrypi0-2w-64 ?= "1"

# avoid pseudo abort due to iwlwifi firmware being cleaned outside of fakeroot - this should be a temporary workaround until https://github.com/balena-os/meta-balena/pull/2270 is merged
IWLWIFI_FW_TOCLEAN:raspberrypi4-64 = ""
IWLWIFI_FW_TOCLEAN:raspberrypi0-2w-64 = ""
```
